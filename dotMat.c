#include <p18f4520.h>
#pragma config OSC=INTIO67

void delay_ms (int ms)
{
	unsigned long int i;
	for (;ms>0;ms--)
	{
		for (i=0;i<80;i++) {};
	}
}

char letraA[]={
	//linha sao ativas aq em 0
	0b11111111,
	0b11111111,
	0b11111111,
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	0b11111111,
	};

int coluna[]={
	//a tabela coluna eh ativa em 1, vou fazer uma varredura nesse vetor
	0b00000001,
	0b00000010,
	0b00000100,
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	0b00000000,
};


void main(void) {
	int i = 0, j = 0;
	TRISA = 0b00000000;
	TRISB = 0b00000000;
	TRISC = 0b00000000;
	TRISD = 0b00000000;

	while(1){ 
		for(j=0;j<53;j++){	
			for (i=0;i<7;i++){
				LATD=coluna[i];
				LATB=letraA[j+i];
				//delay_ms(1);
				LATC=letraA[j+i-7];
					delay_ms(1);
			
			}	
		}
	}
}